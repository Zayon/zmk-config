## boards/shields/hillside_view/Kconfig.shield
```kconfig
# No whitespace after the comma or in the keyboard name!
config SHIELD_HILLSIDE_VIEW_DONGLE
    def_bool $(shields_list_contains,hillside_view_dongle)

config SHIELD_HILLSIDE_VIEW_LEFT
    def_bool $(shields_list_contains,hillside_view_left)

config SHIELD_HILLSIDE_VIEW_RIGHT
    def_bool $(shields_list_contains,hillside_view_right)
```

## config/west.yml
```yaml
manifest:
  defaults:
    revision: v0.3
  remotes:
    - name: zmkfirmware
      url-base: https://github.com/zmkfirmware
    - name: hsv-zmkfirmware
      url-base: https://github.com/mike1808
    - name: zayon
      url-base: https://github.com/Zayon
  projects:
    - name: zmk
      remote: zmkfirmware
      import: app/west.yml
    - name: zmk-module-caps-word-ergol
      remote: zayon
      revision: main
  self:
    path: config
```
